/*------------------------------------------------------------
 * 文件：oled.c
 * 作用：SSD1306 OLED 文本显示驱动，把 4x16 字符抽象映射到 128x64 像素。
 * 框架：
 *   - 字模：8x8 ASCII 字库
 *   - 底层：I2C 命令/数据发送
 *   - 上层：光标控制、写字符、写字符串、清屏、初始化
 *-----------------------------------------------------------*/
#include <REGX52.H>
#include "oled.h"
#include "i2c.h"
#include "delay.h"

#define OLED_ADDR_WRITE      0x78
#define OLED_CTRL_CMD        0x00
#define OLED_CTRL_DATA       0x40
#define OLED_TEXT_ROW_MAX    4
#define OLED_TEXT_COL_MAX    16
#define OLED_CHAR_WIDTH      8

/* 文本光标：以“行/列字符坐标”记录当前位置，便于 UI 像字符屏一样使用 OLED。 */
static unsigned char g_cursor_row = 0;
static unsigned char g_cursor_col = 0;

/* Public domain font source: https://github.com/dhepper/font8x8 */
static unsigned char code OLED_FONT8x8[128][8] =
{
    { 0x00, 0x00, 0x00, 0x00, 0x00, 0x00, 0x00, 0x00 }, /*   0 . */
    { 0x00, 0x00, 0x00, 0x00, 0x00, 0x00, 0x00, 0x00 }, /*   1 . */
    { 0x00, 0x00, 0x00, 0x00, 0x00, 0x00, 0x00, 0x00 }, /*   2 . */
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    { 0x00, 0x00, 0x00, 0x00, 0x00, 0x00, 0x00, 0x00 }, /* 127 . */
};

static void OLED_WriteCommand(unsigned char cmd)
{
    /* 命令帧格式：设备地址(写) + 控制字0x00 + 命令字节。 */
    I2C_Start();
    I2C_Write(OLED_ADDR_WRITE);
    I2C_ReadAck();
    I2C_Write(OLED_CTRL_CMD);
    I2C_ReadAck();
    I2C_Write(cmd);
    I2C_ReadAck();
    I2C_Stop();
}

static void OLED_SetPos(unsigned char page, unsigned char col)
{
    /* SSD1306 定位：page 决定纵向 8 像素页，col 决定横向列地址。 */
    OLED_WriteCommand((unsigned char)(0xB0 | (page & 0x07)));
    OLED_WriteCommand((unsigned char)(0x10 | ((col >> 4) & 0x0F)));
    OLED_WriteCommand((unsigned char)(0x00 | (col & 0x0F)));
}

static void OLED_WriteDataBlock(const unsigned char *dat, unsigned char len)
{
    unsigned char i;
    /* 数据帧格式：设备地址(写) + 控制字0x40 + 连续像素字节。 */
    I2C_Start();
    I2C_Write(OLED_ADDR_WRITE);
    I2C_ReadAck();
    I2C_Write(OLED_CTRL_DATA);
    I2C_ReadAck();
    for (i = 0; i < len; i++)
    {
        I2C_Write(dat[i]);
        I2C_ReadAck();
    }
    I2C_Stop();
}

static void OLED_WriteDataRepeat(unsigned char dat, unsigned char count)
{
    unsigned char i;
    I2C_Start();
    I2C_Write(OLED_ADDR_WRITE);
    I2C_ReadAck();
    I2C_Write(OLED_CTRL_DATA);
    I2C_ReadAck();
    for (i = 0; i < count; i++)
    {
        I2C_Write(dat);
        I2C_ReadAck();
    }
    I2C_Stop();
}

static void OLED_WriteCharAt(unsigned char row, unsigned char col, unsigned char ch)
{
    unsigned char code *glyph;
    unsigned char page;
    unsigned char x;

    if (row >= OLED_TEXT_ROW_MAX || col >= OLED_TEXT_COL_MAX) return; /* 越界保护，防止写出显示区。 */

    glyph = OLED_FONT8x8[ch];
    page = (unsigned char)(row * 2);
    x = (unsigned char)(col * OLED_CHAR_WIDTH);

    /* 8x8 字符按单页写入，形成 4x16 的文本布局。 */
    OLED_SetPos(page, x);
    OLED_WriteDataBlock(glyph, OLED_CHAR_WIDTH);
}

void OLED_WriteChar(unsigned char ch)
{
    OLED_WriteCharAt(g_cursor_row, g_cursor_col, ch);
    if (g_cursor_col + 1 < OLED_TEXT_COL_MAX)
    {
        g_cursor_col++;
    }
}

void OLED_Clear(void)
{
    unsigned char page;
    /* 全屏 8 页逐页清零，每页 128 列。 */
    for (page = 0; page < 8; page++)
    {
        OLED_SetPos(page, 0);
        OLED_WriteDataRepeat(0x00, 128);
    }
    g_cursor_row = 0;
    g_cursor_col = 0;
}

void OLED_SetCursor(unsigned char row, unsigned char col)
{
    if (row < OLED_TEXT_ROW_MAX) g_cursor_row = row;
    if (col < OLED_TEXT_COL_MAX) g_cursor_col = col;
}

void OLED_WriteString(unsigned char row, unsigned char col, char code *str)
{
    OLED_SetCursor(row, col);
    while (*str && g_cursor_col < OLED_TEXT_COL_MAX)
    {
        OLED_WriteChar((unsigned char)*str++);
    }
}

void OLED_Init(void)
{
    /* 上电延时：等待 OLED 内部电源/复位稳定。 */
    DelayMs(100);
    /* 以下是 SSD1306 初始化序列：时钟、复用率、偏移、寻址模式、方向、电荷泵等配置。 */
    OLED_WriteCommand(0xAE);
    OLED_WriteCommand(0xD5);
    OLED_WriteCommand(0x80);
    OLED_WriteCommand(0xA8);
    OLED_WriteCommand(0x3F);
    OLED_WriteCommand(0xD3);
    OLED_WriteCommand(0x00);
    OLED_WriteCommand(0x40);
    OLED_WriteCommand(0x8D);
    OLED_WriteCommand(0x14);
    OLED_WriteCommand(0x20);
    OLED_WriteCommand(0x00);
    OLED_WriteCommand(0xA1);
    OLED_WriteCommand(0xC8);
    OLED_WriteCommand(0xDA);
    OLED_WriteCommand(0x12);
    OLED_WriteCommand(0x81);
    OLED_WriteCommand(0x7F);
    OLED_WriteCommand(0xD9);
    OLED_WriteCommand(0xF1);
    OLED_WriteCommand(0xDB);
    OLED_WriteCommand(0x40);
    OLED_WriteCommand(0xA4);
    OLED_WriteCommand(0xA6);
    OLED_WriteCommand(0xAF);
    /* 初始化后清屏并将光标归位。 */
    OLED_Clear();
}
