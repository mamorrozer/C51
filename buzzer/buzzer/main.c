/**
 * @file main.c
 * @brief 蜂鸣器音乐播放器 - 播放《起风了》
 * @version 1.0
 * @date 2026-03-30
 * @author User
 *
 * 功能说明：
 * - 使用蜂鸣器播放《起风了》歌曲
 * - 通过定时器0控制蜂鸣器发声
 * - 通过定时器1实现数码管动态显示播放进度
 * - 支持实时显示播放进度百分比
 */

#include <REGX52.H>
#include "Delay.h"
#include "time.h"
#include "nixie.h"


//播放歌曲起风了
// 蜂鸣器引脚定义（接在P2.5口，通过高低电平翻转发声）
sbit Buzzer=P2^5;

// 播放速度：四分音符的基础时长（单位ms，数字越大播放越慢）
#define SPEED   470

// 频率表（对应49种音高）
unsigned int FreqTable[] = {
	0,                                      // 0: 休止符
	0xF88B, 0xF8F2, 0xF95B, 0xF9B7, 0xFA14, 0xFA66, 0xFAB9, 0xFB03, 0xFB4A, 0xFB8F, 0xFBCF, 0xFC0B,  // 1-12
	0xFC43, 0xFC78, 0xFCAB, 0xFCDB, 0xFD08, 0xFD33, 0xFD5B, 0xFD81, 0xFDA5, 0xFDC7, 0xFDE7, 0xFE05,  // 13-24
	0xFE21, 0xFE3C, 0xFE55, 0xFE6D, 0xFE84, 0xFE99, 0xFEAD, 0xFEC0, 0xFE02, 0xFEE3, 0xFEF3, 0xFF02,  // 25-36
	0xFF10, 0xFF1D, 0xFF2A, 0xFF36, 0xFF42, 0xFF4C, 0xFF56, 0xFF60, 0xFF69, 0xFF71, 0xFF79, 0xFF81,  // 37-48
};

/**
 * 乐谱数组
 * 格式：【音高】,【时值】, 最后以0xFF结束
 * 音高：对应FreqTable的索引
 * 时值：以四分音符为基准的相对时长
 */
unsigned char code Music[] = {
	0, 4,  // 起始休止符
	18, 2, 19, 2, 21, 2, 23, 2, 11, 4, 26, 2, 23, 6, 0, 2,
	18, 2, 19, 2, 21, 2, 23, 2, 9, 4, 26, 2, 23, 2, 21, 2, 23, 2, 19, 2, 21, 2, 18, 2, 19, 2,
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	0xFF, 0xFF  // 乐曲结束标志
};

// 全局变量
unsigned char FreqSelect;        // 当前选中的音高索引
unsigned char MusicSelect;        // 乐谱播放位置索引
volatile unsigned char statue;    // 数码管显示位选（0: 第1位, 1: 第2位）
volatile unsigned int total_progress; // 乐曲总时值（计算进度用）
volatile unsigned int now_progress;   // 当前已播放时值
volatile unsigned int temp;            // 播放进度百分比（0~100）

/**
 * @brief 主函数
 * @return 无
 *
 * 系统入口函数，实现以下功能：
 * 1. 计算乐曲总时长
 * 2. 初始化定时器0（控制蜂鸣器发声）
 * 3. 初始化定时器1（控制数码管显示）
 * 4. 主循环：播放音乐并实时更新进度
 */
void main()
{
	unsigned int i = 1;  // 乐谱遍历索引，从1开始（跳过第一个休止符）

	// 第一步：遍历乐谱，计算总时长
	while(1)
	{
		if(Music[i] == 0xFF)  // 遇到结束标志
			break;
		total_progress += Music[i];  // 累加时值
		i += 2;  // 每次跳过【音符】+【时值】两个字节
	}

	// 初始化定时器0（发声）+ 定时器1（数码管刷新）
	timer();      // 初始化定时器0
	tim1_Init();  // 初始化定时器1

	// 主循环：播放音乐 + 实时更新进度
	while(1)
	{
		// 计算播放进度百分比 0~100%
		temp = now_progress * 100 / total_progress;

		// 如果未播放完毕
		if(Music[MusicSelect] != 0xFF)
		{
			// 取出当前音高
			FreqSelect = Music[MusicSelect];
			MusicSelect++;

			// 根据时值延时，控制音符播放时长
			// SPEED/4 是八分音符的时长，乘以时值得到实际播放时间
			Delay(SPEED/4 * Music[MusicSelect]);

			// 累计已播放进度
			now_progress += Music[MusicSelect];
			MusicSelect++;

			// 音符之间短暂停顿，避免粘连
			TR0 = 0;      // 暂停定时器0
			Delay(5);     // 5ms短暂停顿
			TR0 = 1;      // 恢复定时器0
		}
		// 乐曲结束，停止播放
		else
		{
			TR0 = 0;      // 关闭定时器0
			while(1);     // 无限循环，程序结束
		}
	}
}

/**
 * @brief 定时器0中断服务函数
 * @return 无
 *
 * 功能：控制蜂鸣器发声
 * 工作原理：
 * 1. 当不是休止符时，根据当前音高加载定时器初值
 * 2. 翻转蜂鸣器引脚电平，产生方波发声
 */
void Timer0_Routine() interrupt 1
{
	// 如果不是休止符（FreqTable[0]为0）
	if(FreqTable[FreqSelect])
	{
		// 装入对应音高的定时器初值
		// 低8位 = 频率值 % 256
		// 高8位 = 频率值 / 256
		TL0 = FreqTable[FreqSelect] % 256;
		TH0 = FreqTable[FreqSelect] / 256;

		// 翻转电平，产生方波让蜂鸣器发声
		Buzzer = !Buzzer;
	}
}

/**
 * @brief 定时器1中断服务函数
 * @return 无
 *
 * 功能：数码管动态显示（1ms刷新一次）
 * 工作原理：
 * 1. 重装定时器初值（1ms中断一次）
 * 2. 每次刷新前先清零段码
 * 3. 调用nixie_display显示当前进度
 * 4. 切换数码管位选，实现动态显示
 */
void time1_It() interrupt 3
{
	// 重装定时器初值（1ms）
	TH1 = 0xFC;  // 高8位
	TL1 = 0x67;  // 低8位

	// 每次刷新前先清零段码，避免鬼影
	P0 = 0x00;

	// 数码管显示当前进度百分比
	nixie_display(temp, statue);

	// 切换数码管位选（两位动态显示）
	statue++;
	if(statue == 2)  // 两位数码管循环显示
		statue = 0;
}